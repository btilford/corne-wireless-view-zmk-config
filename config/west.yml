## config/west.yml
```yaml
manifest:
  remotes:
    - name: zmkfirmware
      url-base: https://github.com/zmkfirmware
    - name: urob
      url-base: https://github.com/urob
  projects:
    - name: zmk
      # remote: zmkfirmware
      remote: urob
      revision: v0.2+fix-child-nodes
      # revision: main
      import: app/west.yml
    - name: zmk-leader-key
      remote: urob
      revision: v0.2
    - name: zmk-helpers
      remote: urob
      revision: v0.2
    - name: zmk-auto-layer
      remote: urob
      revision: v0.2
    - name: zmk-adaptive-key
      remote: urob
      revision: v0.2
    - name: zmk-tri-state
      remote: urob
      revision: v0.2
  self:
    path: config
```
